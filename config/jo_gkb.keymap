/*
 * Copyright (c) 2022 The ZMK Contributors
 *
 * SPDX-License-Identifier: MIT
 */

#include <behaviors.dtsi>
#include <dt-bindings/zmk/keys.h>
#include <dt-bindings/zmk/bt.h>
#include <dt-bindings/zmk/outputs.h>

#define DEFAULT 0
#define LOWER 1

/ {
    keymap {
        compatible = "zmk,keymap";
 
        default_layer {
            bindings = <
                &kp LCTRL
                &kp ESC
                &kp Q
                &kp A
                &kp W
                &kp S
                &kp E
                &kp D
                &lt LOWER LA(TAB)
                &kp SPACE
            >;
        };
        lower_layer {
            bindings = <
                &reset
                &bootloader
                &bt BT_SEL 0
                &bt BT_CLR
                &bt BT_NXT
                &out OUT_BLE
                &bt BT_PRV
                &trans
                &trans
                &trans
            >;
        };
    };
};
