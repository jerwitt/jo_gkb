## config/boards/shields/jo_gkb/Kconfig.defconfig
```kconfig
# Copyright (c) 2022 The ZMK Contributors
# SPDX-License-Identifier: MIT

config ZMK_BLE
  default y

config ZMK_USB
  default y


if SHIELD_JO_GKB

config ZMK_KEYBOARD_NAME
    default "jo Gaming Keyboard"

endif
```
